## app/boards/new_board/board.yml
```yaml
board:
  name:   new_board
  full_name: "new_board"
  vendor: nordic
  socs:
  - name: nrf52832
```

## app/boards/our_board/board.yml
```yaml
board:
  name: our_board
  full_name: our_board Dongle
  vendor: nordic
  socs:
  - name: nrf51822
```
